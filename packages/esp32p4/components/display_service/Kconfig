## packages/esp32p4/components/display_service/Kconfig
```kconfig
menu "the-spring display"

config SPRING_DISPLAY_SPI_FREQUENCY_HZ
    int "Electronic-paper SPI frequency (Hz)"
    range 100000 20000000
    default 1000000

config SPRING_DISPLAY_BUSY_ACTIVE_HIGH
    bool "BUSY signal is active high"
    default y

config SPRING_DISPLAY_PARTIAL_REFRESH_LIMIT
    int "Partial refreshes before a full refresh"
    range 1 255
    default 20

config SPRING_DISPLAY_ENABLE_PARTIAL_REFRESH
    bool "Enable electronic-paper partial refresh"
    default n
    help
        Enable the SSD1683 partial-refresh command sequence. The
        QYEG0420BNS830 panel-specific waveform and update sequence still need
        to be verified on real hardware, so keep this disabled until that
        validation is complete. Disabled mode always sends a full refresh,
        which is slower but keeps the panel RAM and waveform state coherent.

endmenu
```

## packages/esp32p4/components/modem_service/Kconfig
```kconfig
menu "the-spring modem"

config SPRING_MODEM_USE_UART
    bool "Use UART DTE instead of USB"
    default n
    help
        Keep the UART DTE as an explicit compatibility path. The default is the
        EC600M USB dedicated AT bulk port.

config SPRING_MODEM_APN
    string "Cellular APN"
    default "CMNET"

config SPRING_MODEM_USB_VID
    hex "USB modem vendor ID"
    default 0x2C7C

config SPRING_MODEM_USB_PID
    hex "USB modem product ID"
    default 0x6002

config SPRING_MODEM_USB_AT_INTERFACE
    int "EC600M USB dedicated AT interface"
    default 3
    help
        EC600M accepts AT commands only on its dedicated vendor-specific bulk
        interface. This is the primary esp_modem terminal and must match the
        modem USB descriptor. Interface 3 is the validated default for
        EC600MCNLER06A08M08; set this to the descriptor's dedicated AT port
        when firmware exposes a different interface.

config SPRING_MODEM_USB_SECONDARY_INTERFACE
    int "EC600M USB secondary data interface"
    default -1
    help
        Optional secondary bulk data interface. Keep -1 when PPP shares
        the EC600M AT port; the AT interface remains the only control port.

endmenu
```

## packages/esp32p4/components/network_service/Kconfig
```kconfig
menu "the-spring network"

config SPRING_OPENWEATHER_API_KEY
    string "OpenWeather API key"
    default ""

endmenu
```

## packages/esp32p4/components/ui_core/Kconfig
```kconfig
menu "Spring UI"

config SPRING_DISPLAY_BUFFER_ONLY
    bool "Run display in buffer-only mode"
    default n
    help
        Keep the framebuffer and UI routing active without touching the
        electronic-paper GPIO or SPI bus. Disable when the panel is connected.

config SPRING_LVGL_DECLARATIVE_UI
    bool "Use LVGL 9.5 declarative UI host"
    default y
    help
        Render the XML-defined screens through the LVGL 9.5 software renderer.

endmenu
```

## packages/esp32p4/components/weather_service/Kconfig
```kconfig
menu "the-spring weather"

config SPRING_OPENWEATHER_API_KEY
    string "OpenWeather API key"
    default ""

endmenu
```

## packages/esp32p4/sdkconfig.defaults
```kconfig
CONFIG_IDF_TARGET="esp32p4"
CONFIG_ESP32P4_SELECTS_REV_LESS_V3=y
CONFIG_ESP32P4_REV_MIN_100=y
CONFIG_ESP_DEFAULT_CPU_FREQ_MHZ_360=y
CONFIG_PARTITION_TABLE_CUSTOM=y
CONFIG_PARTITION_TABLE_CUSTOM_FILENAME="partitions.csv"
CONFIG_PARTITION_TABLE_FILENAME="partitions.csv"
CONFIG_BOOTLOADER_APP_ROLLBACK_ENABLE=y
CONFIG_BOOTLOADER_SKIP_VALIDATE_IN_DEEP_SLEEP=y
CONFIG_ESP_HTTP_CLIENT_ENABLE_HTTPS=y
CONFIG_FREERTOS_HZ=1000
CONFIG_SPIRAM=y
CONFIG_SPIRAM_USE_MALLOC=y
CONFIG_ESPTOOLPY_FLASHSIZE_16MB=y
CONFIG_FATFS_LFN_HEAP=y
CONFIG_FATFS_LFN_STACK=n
CONFIG_SPRING_DISPLAY_BUFFER_ONLY=n
CONFIG_SPRING_OPENWEATHER_API_KEY=""
CONFIG_LV_BUILD_EXAMPLES=n
CONFIG_LV_BUILD_DEMOS=n
CONFIG_LV_USE_VECTOR_GRAPHIC=y
CONFIG_LV_USE_FLOAT=y
CONFIG_LV_USE_MATRIX=y
CONFIG_LV_USE_SVG=y
CONFIG_LV_USE_THORVG=y
CONFIG_LV_USE_THORVG_INTERNAL=y
CONFIG_LV_USE_TINY_TTF=y
CONFIG_LV_USE_CLIB_MALLOC=y
CONFIG_ESP_MAIN_TASK_STACK_SIZE=24576
CONFIG_LV_TINY_TTF_FILE_SUPPORT=n
CONFIG_SPRING_LVGL_DECLARATIVE_UI=y
CONFIG_MBEDTLS_CERTIFICATE_BUNDLE=y
CONFIG_MBEDTLS_CERTIFICATE_BUNDLE_DEFAULT_FULL=y
# The P4 host uses its on-board ESP32-C6 over the board's internal SDIO bus.
CONFIG_ESP_HOSTED=y
CONFIG_ESP_HOSTED_HOST=y
CONFIG_ESP_HOSTED_HOST_TYPE_MCU=y
CONFIG_ESP_HOSTED_CP_TARGET_ESP32C6=y
CONFIG_ESP_HOSTED_HOST_TRANSPORT_BUS_SDIO=y
CONFIG_ESP_HOSTED_SDIO_SLOT_1=y
CONFIG_ESP_HOSTED_HOST_SDIO_CLK_KHZ=40000
CONFIG_ESP_HOSTED_HOST_SDIO_BUS_WIDTH_4=y
CONFIG_ESP_HOSTED_HOST_RESET_GPIO=54
```
